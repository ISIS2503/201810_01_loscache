#include <PubSubClient.h>
#include <ESP8266WiFi.h>
 

//DEFINES
#define TOPIC_SUBSCRIBE        "unirest1.inmueble1.sensor1.config"
#define TOPIC_PUBLISH          "unirest1.inmueble1.sensor1"

#define SIZE_BUFFER_DATA       100



int alarma = 0;

String idDevice = "sensor1";
boolean     stringComplete = false;
boolean     init_flag = false;
String      inputString = "";
char        bufferData [SIZE_BUFFER_DATA];

// CLIENTE WIFI & MQTT`
WiFiClientSecure    clientWIFI;
PubSubClient  clientMQTT(clientWIFI);

// CONFIG WIFI
char* ssid = "isis2503";
char* password = "Yale2018.";

// CONFIG SECURITY - SSL
unsigned char m2mqtt_ca_bin_crt[] = {
  0x30, 0x82, 0x03, 0xff, 0x30, 0x82, 0x02, 0xe7, 0xa0, 0x03, 0x02, 0x01,
  0x02, 0x02, 0x09, 0x00, 0x86, 0x89, 0x79, 0xa5, 0x54, 0x8c, 0x0b, 0xb1,
  0x30, 0x0d, 0x06, 0x09, 0x2a, 0x86, 0x48, 0x86, 0xf7, 0x0d, 0x01, 0x01,
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  0xb7, 0xd9, 0x23, 0x89, 0xeb, 0x88, 0xb6
};
unsigned int m2mqtt_ca_bin_crt_len = 1027;


// CONFIG MQTT
IPAddress serverMQTT (172,24,41,211);
const uint16_t portMQTT = 8090;
const char* usernameMQTT = "microcontrolador";
const char* passwordMQTT = "Isis2503.";

// FUNCTIONS
String macToStr(const uint8_t* mac) {
  String result;
  for (int i = 0; i < 6; ++i) {
    result += String(mac[i], 16);
    if (i < 5)
      result += ':';
  }
  return result;
}

void connectWIFI() {
  // Conectar a la red WiFi
  Serial.println();
  Serial.print("Connecting to ");
  Serial.println(ssid);
 
  //WiFi.mode(WIFI_STA);
  if(WiFi.status() != WL_CONNECTED) {
    WiFi.begin(ssid, password);
  }
 
  while (WiFi.status() != WL_CONNECTED) {
    delay(500);
    Serial.print(".");
  }
  Serial.println("WiFi connected");
 
  // Obtain MAC Address
  uint8_t mac[6];
  WiFi.macAddress(mac);
  idDevice = macToStr(mac);
  Serial.print("MAC Address: ");
  Serial.println(idDevice);
 
  // Obtain IP Address
  Serial.print("IP Address: ");
  Serial.println(WiFi.localIP());
}
 
void reconnectWIFI() {
  // Conectar a la red WiFi
  if(WiFi.status() != WL_CONNECTED) {
    WiFi.begin(ssid, password);
  }
 
  while (WiFi.status() != WL_CONNECTED) {
    delay(500);
  }
}
 
void callback(char* topic, byte* payload, unsigned int length) {
  Serial.write(payload, length);
  Serial.println();
}
 
void setup() {
  Serial.begin(9600);
  inputString.reserve(100);
 
  clientWIFI.setCACert(m2mqtt_ca_bin_crt, m2mqtt_ca_bin_crt_len);
 
  clientMQTT.setServer(serverMQTT, portMQTT);
  clientMQTT.setCallback(callback);
  connectWIFI();
  delay(1000);
}
 
void processData() {
  if (WiFi.status() == WL_CONNECTED) {
    if(init_flag == false) {
      init_flag = true;
 
      boolean conectMQTT = false;
      if (!clientMQTT.connected()) {
        if (!clientMQTT.connect(idDevice.c_str(), usernameMQTT, passwordMQTT)) {
          conectMQTT = false;
        }
        conectMQTT = true;
      }
      else {
        conectMQTT = true;
      }
 
      if(conectMQTT) {
        if(clientMQTT.subscribe(TOPIC_SUBSCRIBE)) {
          // Serial.println("Subscribe OK");
        }
      }
    }
 
    if (stringComplete && clientMQTT.connected()) {
      if(clientMQTT.publish(TOPIC_PUBLISH, bufferData)) {
        inputString = "";
        stringComplete = false;
      }
      init_flag = false;
    }
  }
  else {
    reconnectWIFI();
    init_flag = false;
  }
  clientMQTT.loop();
}
 
void receiveData() {
  while (Serial.available()) {
    // get the new byte:
    char inChar = (char)Serial.read();
    // add it to the inputString:
    inputString += inChar;
    if (inChar == '\n') {
      inputString.toCharArray(bufferData, SIZE_BUFFER_DATA);
      stringComplete = true;
    }
  }
}
 
void loop() {
  receiveData();
  processData();
}
